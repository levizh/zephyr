## boards/arm/hc32f460_evb/Kconfig.board
```kconfig
# Kconfig - HC32F460_EVB board configuration
# Copyright (C) 2022-2024, Xiaohua Semiconductor Co., Ltd.
# SPDX-License-Identifier: Apache-2.0
#

config BOARD_HC32F460_EVB
	bool "EV_F460_LQ100_REV2.0 Development Board"
	depends on SOC_HC32F460
```

## boards/arm/hc32f460_evb/Kconfig.defconfig
```kconfig
# Kconfig - HC32F460_EVB board configuration
# Copyright (C) 2022-2024, Xiaohua Semiconductor Co., Ltd.
# SPDX-License-Identifier: Apache-2.0
#

if BOARD_HC32F460_EVB

config BOARD
	default "hc32f460_evb"

if UART_CONSOLE

config UART_4
	default y

endif # UART_CONSOLE

endif # BOARD_HC32F460_EVB
```

## boards/arm/hc32f4a0_evb/Kconfig.board
```kconfig
# Kconfig - HC32F460_EVB board configuration
# Copyright (C) 2022-2024, Xiaohua Semiconductor Co., Ltd.
# SPDX-License-Identifier: Apache-2.0
#

config BOARD_HC32F4A0_EVB
	bool "EV_F4A0_LQ176_REV2.0 Development Board"
	depends on SOC_HC32F4A0
```

## boards/arm/hc32f4a0_evb/Kconfig.defconfig
```kconfig
# Kconfig - HC32F460_EVB board configuration
# Copyright (C) 2022-2024, Xiaohua Semiconductor Co., Ltd.
# SPDX-License-Identifier: Apache-2.0
#

if BOARD_HC32F4A0_EVB

config BOARD
	default "hc32f4a0_evb"

endif # BOARD_HC32F4A0_EVB
```

## boards/xhsc/hc32f460_evb/Kconfig.hc32f460_evb
```kconfig
# Copyright (C) 2022-2024, Xiaohua Semiconductor Co., Ltd.
# SPDX-License-Identifier: Apache-2.0

config BOARD_HC32F460_EVB
	select SOC_HC32F460
```

## boards/xhsc/hc32f4a0_evb/Kconfig.hc32f4a0_evb
```kconfig
# Copyright (C) 2022-2024, Xiaohua Semiconductor Co., Ltd.
# SPDX-License-Identifier: Apache-2.0

config BOARD_HC32F4A0_EVB
	select SOC_HC32F4A0
```

## drivers/adc/Kconfig.hc32
```kconfig
# ADC configuration options
# SPDX-License-Identifier: Apache-2.0

config ADC_HC32
	bool "HC32 ADC driver"
	default y
	depends on DT_HAS_XHSC_HC32_ADC_ENABLED
	select HC32_LL_ADC
	help
	  Enable the driver implementation for the HC32 serials ADC

if ADC_HC32

	config ADC_HC32_DMA
		bool "HC32 MCU ADC DMA Support"
		default y
		select DMA
		depends on ADC_HC32 && ADC_ASYNC
		help
		Enable the ADC DMA mode for ADC instances
		that enable dma channels in their device tree node.

	config ADC_HC32_INTERRUPT
		bool "HC32 ADC shared interrupts"
		default y
		depends on ADC_HC32
		help
		Enable the use of shared interrupts
endif
```

## drivers/can/Kconfig.hc32
```kconfig
# Copyright (C) 2022-2024, Xiaohua Semiconductor Co., Ltd.
#
# SPDX-License-Identifier: Apache-2.0

config CAN_HC32
	bool "HC32 CAN Driver"
	depends on SOC_FAMILY_HC32
    select HC32_LL_CAN
	help
	  Enable HC32 CAN Driver

config CAN_MAX_FILTER
	int "Maximum number of concurrent active filters"
	depends on CAN_HC32
	default 4
	range 1 8
	help
	  Defines the array size of the callback/msgq pointers.

config CAN_TIMEOUT_WAIT_CONFIG
	int "Maximum timeout time(ms) for waiting to configure CAN"
	depends on CAN_HC32
	default 100
```

## drivers/clock_control/Kconfig.hc32
```kconfig
# Copyright (C) 2024-2025, Xiaohua Semiconductor Co., Ltd.
# SPDX-License-Identifier: Apache-2.0

config CLOCK_CONTROL_HC32
	bool "HC32 Clock Control"

if CLOCK_CONTROL_HC32

config HC32_LL_CLK
	bool
	default y

endif
```

## drivers/clock_control/Kconfig.hc32f4
```kconfig
# Copyright (C) 2022-2024, Xiaohua Semiconductor Co., Ltd.

if SOC_FAMILY_HC32
menuconfig CLOCK_CONTROL_HC32
	bool "HC32 Clock Control"
	select HC32_LL_PWC
endif

if CLOCK_CONTROL_HC32
menu "HC32 CLK SYSTEM CONFIG"
	config HC32_CLK_XTAL
		bool "HC32 xtal control"
		default y

	config HC32_CLK_XTAL32
		bool "HC32 xtal32 control"
		default y

	config HC32_CLK_HRC
		bool "HC32 hrc control"
		default y

	config HC32_CLK_MRC
		bool "HC32 mrc control"
		default y

	config HC32_CLK_LRC
		bool "HC32 lrc control"
		default y
endmenu

choice	HC32_SYSCLK_SRC
prompt "HC32 System Clock Source"
	default HC32_SYSCLK_SRC_PLL

config HC32_SYSCLK_SRC_PLL
	bool "select pll as system clock"
	help
	  select pll as system clock

config HC32_SYSCLK_SRC_XTAL
	bool "select xtal as system clock"
	select HC32_CLK_XTAL
	help
	  select xtal as system clock

config HC32_SYSCLK_SRC_HRC
	bool "select hrc as system clock"
	select HC32_CLK_HRC
	help
	  select hrc as system clock

config HC32_SYSCLK_SRC_MRC
	bool "select mrc as system clock"
	select HC32_CLK_MRC
	help
	  select mrc as system clock

config HC32_SYSCLK_SRC_LRC
	bool "select lrc as system clock"
	select HC32_CLK_LRC
	help
	  select lrc as system clock

config HC32_SYSCLK_SRC_XTAL32
	bool "select xtal32 as system clock"
	select HC32_CLK_XTAL32
	help
	  select xtal32 as system clock
endchoice

choice	HC32_PLL_SRC
prompt "HC32 PLL Clock Source"
	depends on HC32_SYSCLK_SRC_PLL
	default HC32_PLL_SRC_XTAL

config HC32_PLL_SRC_XTAL
	bool "xtal"
	select HC32_CLK_XTAL
	help
	  select xtal as pll clock source

config HC32_PLL_SRC_HRC
	bool "hrc"
	select HC32_CLK_HRC
	help
	  select hrc as pll clock source
endchoice

menu "HC32_BUS_CONFIG"
	config HC32_BUS_HCLK_DIV
		int "HC32 hclk division, allowed values:1, 2, 4, 8, 16, 32, 64"
		default 1
		help
		allowed values:1, 2, 4, 8, 16, 32, 64

	config HC32_BUS_EXCLK_DIV
		int "HC32 exclk division, allowed values:1, 2, 4, 8, 16, 32, 64"
		default 2
		help
		allowed values:1, 2, 4, 8, 16, 32, 64

	config HC32_BUS_PCLK0_DIV
		int "HC32 pclk0 division, allowed values:1, 2, 4, 8, 16, 32, 64"
		default 1
		help
		allowed values:1, 2, 4, 8, 16, 32, 64

	config HC32_BUS_PCLK1_DIV
		int "HC32 pclk1 division, allowed values:1, 2, 4, 8, 16, 32, 64"
		default 2
		help
		allowed values:1, 2, 4, 8, 16, 32, 64

	config HC32_BUS_PCLK2_DIV
		int "HC32 pclk2 division, allowed values:1, 2, 4, 8, 16, 32, 64"
		default 4
		help
		allowed values:1, 2, 4, 8, 16, 32, 64

	config HC32_BUS_PCLK3_DIV
		int "HC32 pclk3 division, allowed values:1, 2, 4, 8, 16, 32, 64"
		default 4
		help
		allowed values:1, 2, 4, 8, 16, 32, 64

	config HC32_BUS_PCLK4_DIV
		int "HC32 pclk4 division, allowed values:1, 2, 4, 8, 16, 32, 64"
		default 2
		help
		allowed values:1, 2, 4, 8, 16, 32, 64
endmenu

menu "HC32_PLL_CONFIG"
depends on HC32_SYSCLK_SRC_PLL
	config HC32_PLL_DIV_M
		int "Division factor for PLL, Valid range: 1 - 24"
		default 1
		help
		input clock, Valid range: 1 - 24

	config HC32_PLL_MUL_N
		int "Main PLL multiplication factor for VCO, Valid range: 20 - 480"
		default 50
		help
		Valid range: 20 - 480

	config HC32_PLL_DIV_P
		int "PLL division factor for pll_p_ck, Valid range: 2 - 16"
		default 2
		help
		Valid range: 2 - 16

	config HC32_PLL_DIV_Q
		int "PLL division factor for pll_q_ck, Valid range: 2 - 16"
		default 2
		help
		Valid range: 2 - 16

	config HC32_PLL_DIV_R
		int "PLL division factor for pll_r_ck, Valid range: 2 - 16"
		default 2
		help
		Valid range: 2 - 16
endmenu

choice HC32_XTAL32_DRV_SELECT
	bool "Select XTAL32 driver power"
	depends on HC32_CLK_XTAL32
	default HC32_XTAL32_DRV_M

config HC32_XTAL32_DRV_H
	bool "High Driver"
	depends on HC32_CLK_XTAL32
	help
	  Select High Driver for XTAL32

config HC32_XTAL32_DRV_M
	bool "medium Driver"
	depends on HC32_CLK_XTAL32
	help
	  Select medium Driver for XTAL32
endchoice

config HC32_XTAL32_DRV
	int
	default 0 if HC32_XTAL32_DRV_M
	default 1 if HC32_XTAL32_DRV_H

menu "HC32 CLK SYSTEM FREQ SET"
config HC32_XTAL_FREQ
	int "set xtal frequercy"
	default 8000000 if HC32_CLK_XTAL

config HC32_XTAL32_FREQ
	int "set xtal32 frequercy"
	default 32768 if HC32_CLK_XTAL32

config HC32_HRC_FREQ
	int "set hrc frequercy"
	default 16000000 if HC32_CLK_HRC

config HC32_MRC_FREQ
	int "set mrc frequercy"
	default 8000000 if HC32_CLK_MRC

config HC32_LRC_FREQ
	int "set lrc frequercy"
	default 32768 if HC32_CLK_LRC
endmenu
endif
```

## drivers/counter/Kconfig.hc32_rtc
```kconfig
# Copyright (C) 2022-2024, Xiaohua Semiconductor Co., Ltd.
# SPDX-License-Identifier: Apache-2.0

menuconfig COUNTER_RTC_HC32
	bool "HC32 Counter RTC driver"
	default y if !RTC
	depends on DT_HAS_XHSC_HC32_RTC_ENABLED
	select HC32_LL_RTC
	help
	  Build RTC driver for HC32 SoCs.
	  Please note: The alarm has an accuracy of 1 minute.

if COUNTER_RTC_HC32

config COUNTER_RTC_HC32_SAVE_VALUE_BETWEEN_RESETS
	bool "Save rtc time value between resets"
	default n
	help
	  Keep the counter value after each reset.

endif # COUNTER_RTC_HC32
```

## drivers/counter/Kconfig.hc32_timer
```kconfig
# Copyright (C) 2022-2024, Xiaohua Semiconductor Co., Ltd.
#
# SPDX-License-Identifier: Apache-2.0

config COUNTER_TIMERA_HC32
	bool "HC32 counter driver"
	default y
	depends on DT_HAS_XHSC_HC32_TIMERA_COUNTER_ENABLED
	select HC32_LL_TMRA
	select RESET
	help
	  Enable the counter driver for HC32 family of processors.

config COUNTER_TIMER4_HC32
	bool "HC32 counter driver"
	default y
	depends on DT_HAS_XHSC_HC32_TIMER4_COUNTER_ENABLED
	select HC32_LL_TMR4
	select RESET
	help
	  Enable the counter driver for HC32 family of processors.

config COUNTER_TIMER6_HC32
	bool "HC32 counter driver"
	default y
	depends on DT_HAS_XHSC_HC32_TIMER6_COUNTER_ENABLED
	select HC32_LL_TMR6
	select RESET
	help
	  Enable the counter driver for HC32 family of processors.
```

## drivers/dma/Kconfig.hc32
```kconfig
# Kconfig - DMA configuration options
#
#
# Copyright (C) 2022-2024, Xiaohua Semiconductor Co., Ltd.
#
# SPDX-License-Identifier: Apache-2.0
#

menuconfig DMA_HC32
	bool "Enable HC32 DMA driver"
	default y if SOC_FAMILY_HC32
	select HC32_LL_DMA
	select HC32_LL_AOS
	help
	  DMA driver for HC32 Family SoCs.
```

## drivers/flash/Kconfig.hc32
```kconfig
config SOC_FLASH_HC32
	bool "HC32 flash driver"
	select FLASH_HAS_DRIVER_ENABLED
	select FLASH_HAS_PAGE_LAYOUT
	select FLASH_PAGE_LAYOUT
	select HC32_LL_EFM
	default y
	select FLASH_HAS_EX_OP if SOC_SERIES_HC32F4X
	select MPU_ALLOW_FLASH_WRITE if ARM_MPU
	help
	  Enable flash driver for HC32 series

if SOC_FLASH_HC32

config FLASH_HC32_WRITE_PROTECT
	bool "Extended operation for flash write protection control"
	depends on SOC_SERIES_HC32F4X
	default n
	help
	  Enables flash extended operation for enabling/disabling flash write
	  protection.

config FLASH_HC32_WRITE_PROTECT_DISABLE_PREVENTION
	bool "Prevent from disabling flash write protection"
	depends on FLASH_HC32_WRITE_PROTECT
	default n
	help
	  If enabled, all requests to disable flash write protection will be
	  blocked.

config FLASH_HC32_READOUT_PROTECTION
	bool "Extended operation for flash readout protection control"
	depends on SOC_SERIES_HC32F4X
	default n
	help
	  Enables flash extended operation for enabling/disabling flash readout
	  protection.

config FLASH_HC32_READOUT_PROTECTION_DISABLE_ALLOW
	bool "Allow disabling readout protection"
	depends on FLASH_HC32_READOUT_PROTECTION
	default n
	help
	  With this option enabled it will be possible to disable readout
	  protection. On HC32 devices it will trigger flash mass erase!

config FLASH_HC32_READOUT_PROTECTION_PERMANENT_ALLOW
	bool "Allow enabling readout protection permanently"
	depends on FLASH_HC32_READOUT_PROTECTION
	default n
	help
	  With this option enabled it will be possible to enable readout
	  protection permanently.

endif # SOC_FLASH_HC32
```

## drivers/flash/Kconfig.hc32_qspi
```kconfig
# Copyright (C) 2022-2024, Xiaohua Semiconductor Co., Ltd.
# SPDX-License-Identifier: Apache-2.0

config FLASH_HC32_QSPI
	bool "HC32 Quad SPI Flash driver"
	default y
	depends on DT_HAS_XHSC_HC32_QSPI_ENABLED
	select HC32_LL_QSPI
	select FLASH_PAGE_LAYOUT
	select FLASH_HAS_PAGE_LAYOUT
	help
	  Enable QSPI-NOR support on the HC32 family of processors.
```

## drivers/i2c/Kconfig.hc32
```kconfig
# Copyright (c) 2018 Intel Corporation
# SPDX-License-Identifier: Apache-2.0

menuconfig I2C_HC32
	bool "HC32 I2C driver"
	depends on SOC_FAMILY_HC32
	select HC32_LL_I2C
	help
	  Enable I2C support on the HC32 SoCs

if I2C_HC32

choice I2C_TRANSFER_MODE
	bool "Select i2c transfer mode"
	default I2C_HC32_INTERRUPT

config I2C_HC32_INTERRUPT
	bool "HC32 MCU I2C Interrupt Support"
	help
	  Enable Interrupt support for the I2C Driver

config I2C_HC32_DMA
	bool "HC32 MCU I2C DMA Support"
	select DMA
	select DMA_HC32
	help
	  Enable DMA support for the I2C Driver
endchoice

config I2C_HC32_BUS_RECOVERY
	bool "Bus recovery support"
	default n
	select I2C_BITBANG
	help
	  Enable HC32 driver bus recovery support via GPIO bitbanging.

if I2C_HC32_INTERRUPT

config I2C_HC32_INTERRUPT_SHARE
	bool "I2C share interrupt enable"
	default y if SOC_HC32F4A0
	default n if SOC_HC32F460
	help
	  If set n, please reference user manual to 
	  change I2C interrupts number in devicetree

endif

endif # I2C_HC32
```

## drivers/i2s/Kconfig.hc32
```kconfig
# Copyright (C) 2022-2024, Xiaohua Semiconductor Co., Ltd.
# SPDX-License-Identifier: Apache-2.0

menuconfig I2S_HC32
	bool "HC32 MCU I2S controller driver"
	select HC32_LL_I2S
	select DMA
	select DMA_HC32
	help
	  Enable I2S support on the HC32 family of processors.
	  (Tested on the STM32F4 series)

if I2S_HC32

config I2S_HC32_RX_BLOCK_COUNT
	int "RX queue length"
	default 4

config I2S_HC32_TX_BLOCK_COUNT
	int "TX queue length"
	default 4

endif # I2S_HC32
```

## drivers/interrupt_controller/Kconfig.hc32
```kconfig
# Copyright (C) 2022-2024, Xiaohua Semiconductor Co., Ltd.
#
# SPDX-License-Identifier: Apache-2.0

config INTC_HC32
	bool "Interrupt/Event Controller (INTC) Driver for HC32 family of MCUs"
	default y if SOC_FAMILY_HC32
	select HC32_LL_INTERRUPTS
	select HC32_LL_INTERRUPTS_SHARE
	help
	  Enable INTC driver for HC32 line of MCUs


config INTC_EXTINT_HC32
	bool "External Interrupt Controller (EXTINT) Driver for HC32 family of MCUs"
	default y if SOC_FAMILY_HC32
	select HC32_LL_INTERRUPTS
	help
	  Enable EXTINT driver for HC32 line of MCUs

if INTC_EXTINT_HC32

config INTC_EXTINT_USE_SHARE_INTERRUPT
	bool "INTC EXTINT used share interrupt"
	default y
	help
	  INTC EXTINT respond to irq handlers with share interrupt.

endif # INTC_EXTINT_HC32
```

## drivers/pinmux/Kconfig.hc32
```kconfig
# Copyright (C) 2022-2024, Xiaohua Semiconductor Co., Ltd.
#
# SPDX-License-Identifier: Apache-2.0
#

menuconfig PINMUX_HC32
	bool "HC32 Pin multiplexer driver"
	default y if PINMUX
	depends on SOC_SERIES_HC32F4
	depends on GPIO_HC32
	help
	  Enable driver for hc32f4 series Pin multiplexer.

if PINMUX_HC32

config PINMUX_HC32_PORTA_NAME
	string "Pinmux Port A driver name"
	default "porta"

config PINMUX_HC32_PORTB_NAME
	string "Pinmux Port B driver name"
	default "portb"

config PINMUX_HC32_PORTC_NAME
	string "Pinmux Port C driver name"
	default "portc"

config PINMUX_HC32_PORTD_NAME
	string "Pinmux Port D driver name"
	default "portd"

config PINMUX_HC32_PORTE_NAME
	string "Pinmux Port E driver name"
	default "porte"

config PINMUX_HC32_PORTF_NAME
	string "Pinmux Port F driver name"
	default "portf"

config PINMUX_HC32_PORTG_NAME
	string "Pinmux Port G driver name"
	default "portg"

config PINMUX_HC32_PORTH_NAME
	string "Pinmux Port H driver name"
	default "porth"

config PINMUX_HC32_PORTI_NAME
	string "Pinmux Port I driver name"
	default "porti"

endif # PINMUX_HC32
```

## drivers/pwm/Kconfig.hc32_timer6
```kconfig
# XHSC HC32 PWM configuration options

# Copyright (C) 2022-2024, Xiaohua Semiconductor Co., Ltd.
# SPDX-License-Identifier: Apache-2.0

config PWM_HC32_TIMER6
	bool "HC32 MCU TIMER6 PWM driver"
	default y if PWM
	depends on DT_HAS_XHSC_HC32_TIMER6_PWM_ENABLED
	select HC32_LL_TMR6
	help
	  This option enables the PWM driver for HC32 family of
	  processors. Say y if you wish to use PWM port on HC32
	  MCU.
```
