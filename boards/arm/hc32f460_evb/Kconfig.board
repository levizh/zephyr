## drivers/pwm/Kconfig.hc32_timera
```kconfig
# XHSC HC32 PWM configuration options

# Copyright (C) 2022-2024, Xiaohua Semiconductor Co., Ltd.
# SPDX-License-Identifier: Apache-2.0

config PWM_HC32_TIMERA
	bool "HC32 MCU TIMERA PWM driver"
	default y if PWM
	depends on DT_HAS_XHSC_HC32_TIMERA_PWM_ENABLED
	select HC32_LL_TMRA
	help
	  This option enables the PWM driver for HC32 family of
	  processors. Say y if you wish to use PWM port on HC32
	  MCU.

if PWM_HC32_TIMERA

config HC32_TIMERA_CAPTURE_FREQ_HIGH
	bool "HC32 MCU TIMERA CAPTURE FREQ IS HIGH"
	default y if PWM_HC32_TIMERA
	help
	  If the capture frequency is greater than 10khz, then this option should be y,
	  otherwise it should be n.

endif
```

## drivers/rtc/Kconfig.hc32
```kconfig
# Copyright (C) 2022-2024, Xiaohua Semiconductor Co., Ltd.
# SPDX-License-Identifier: Apache-2.0

config RTC_HC32
	bool "HC32 RTC driver"
	default y if !COUNTER
	depends on DT_HAS_XHSC_HC32_RTC_ENABLED
	select HC32_LL_RTC
	help
	  Build RTC driver for HC32 SoCs.
```

## drivers/sensor/qdec_hc32/Kconfig
```kconfig
# Copyright (C) 2022-2024, Xiaohua Semiconductor Co., Ltd.
# SPDX-License-Identifier: Apache-2.0
#

config QDEC_HC32
	bool "HC32 QDEC driver"
	default y
	depends on DT_HAS_XHSC_HC32_QDEC_ENABLED
	select HC32_LL_TMRA
	help
	  HC32 family Quadrature Decoder driver.
```

## drivers/serial/Kconfig.hc32
```kconfig
# license to be added

menuconfig UART_HC32
	bool "HC32 MCU serial driver"
	select SERIAL_HAS_DRIVER
	select SERIAL_SUPPORT_INTERRUPT
	select HC32_LL_USART
	depends on SOC_FAMILY_HC32
	help
	  This option enables the UART driver for HC32 family of
	  processors.
	  Set y if you wish to use serial port on HC32 MCU.

if UART_HC32

config UART_1
	bool "Enable HC32 USART1 Port"
	help
	  Enable support for USART1 port in the driver.
	  Set y here if you want to use USART1 device.

config UART_2
	bool "Enable HC32 USART2 Port"
	help
	  Enable support for USART2 port in the driver.
	  Set y here if you want to use USART2 device.

config UART_3
	bool "Enable HC32 USART3 Port"
	help
	  Enable support for USART3 port in the driver.
	  Set y here if you want to use USART3 device.

config UART_4
	bool "Enable HC32 U(S)ART4 Port"
	help
	  Enable support for U(S)ART4 port in the driver.
	  Set y here if you want to use U(S)ART4 device.


endif # UART_HC32
```
