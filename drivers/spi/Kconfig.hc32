## drivers/spi/Kconfig.hc32
```kconfig
#
# Copyright (C) 2022-2024, Xiaohua Semiconductor Co., Ltd.
#
# SPDX-License-Identifier: Apache-2.0
#

menuconfig SPI_HC32
	bool "HC32 MCU SPI controller driver"
	depends on SOC_FAMILY_HC32
	select HC32_LL_SPI
	select PINMUX_HC32
	help
	  Enable SPI support on the HC32 family of processors.

if SPI_HC32

config SPI_HC32_INTERRUPT
	bool "HC32 MCU SPI Interrupt Support"
	default y if SPI_ASYNC
	help
	  Enable Interrupt support for the SPI Driver of HC32 family.

config SPI_HC32_DMA
	bool "HC32 MCU SPI DMA Support"
	depends on DMA
	select HC32_LL_DMA
	select DMA_HC32
	help
	  Use the DMA for SPI transfer
	  that enable dma channels in their device tree node.

config SPI_HC32_DMA_TIMEOUT
	int "Timeout for dma reg operation, unit millisecond"
	depends on SPI_HC32_DMA
	default 20
	help
	  The time set for wait for dma reg operation done.

endif # SPI_HC32
```

## drivers/spi/Kconfig.qspi_hc32
```kconfig
#
# Copyright (C) 2022-2024, Xiaohua Semiconductor Co., Ltd.
#
# SPDX-License-Identifier: Apache-2.0
#

menuconfig QSPI_HC32
	bool "HC32 MCU SPI controller driver"
	depends on SOC_FAMILY_HC32
	select HC32_LL_QSPI
	select PINMUX_HC32
	help
	  Enable SPI support on the HC32 family of processors.

if QSPI_HC32

config QSPI_HC32_DMA
	bool "HC32 MCU SPI DMA Support"
	depends on DMA
	select HC32_LL_DMA
	select DMA_HC32
	help
	  Use the DMA for SPI transfer
	  that enable dma channels in their device tree node.

config QSPI_HC32_DMA_TIMEOUT
	int "Timeout for dma reg operation, unit millisecond"
	depends on QSPI_HC32_DMA
	default 20
	help
	  The time set for wait for dma reg operation done.

endif # QSPI_HC32
```

## drivers/watchdog/Kconfig.hc32
```kconfig
# Copyright (C) 2022-2024, Xiaohua Semiconductor Co., Ltd.
#
# SPDX-License-Identifier: Apache-2.0

config WDT_HC32
	bool "Watchdog Timer (WDT) Driver for HC32 family of MCUs"
	default y
	depends on DT_HAS_XHSC_HC32_WATCHDOG_ENABLED
	select HC32_LL_WDT
	select HC32_LL_CLK
	select HC32_LL_DBGC
	help
	  Enable WDT driver for HC32 line of MCUs

config SWDT_HC32
	bool "Specialized Watchdog Timer (SWDT) Driver for HC32 family of MCUs"
	default y
	depends on DT_HAS_XHSC_HC32_SPECIALIZED_WATCHDOG_ENABLED
	select HC32_LL_SWDT
	select HC32_LL_CLK
	select HC32_LL_DBGC
	help
	  Enable SWDT driver for HC32 line of MCUs
```

## dts/bindings/adc/xhsc,hc32-adc.yaml
```yaml
# Copyright (c) 2021, Linaro ltd
# SPDX-License-Identifier: Apache-2.0

compatible: "xhsc,hc32-adc"

include: [adc-controller.yaml, pinctrl-device.yaml]

properties:
  reg:
    required: true

  clocks:
    required: true

  sample-time:
    type: array
    description: Specify sample time with cycle number of adc clock.
        The calculation of this parameter please refer to the ADC_SSTR of RM.

  vref-mv:
    type: int
    default: 3300
    description: Indicates the reference voltage of the ADC in mV (on the target board).

  interrupts:
    required: true

  interrupt-names:
    required: true

  pinctrl-0:
    required: true

  pinctrl-names:
    required: true

  "#io-channel-cells":
    const: 1

io-channel-cells:
  - input
```

## dts/bindings/can/xhsc,hc32-can.yaml
```yaml
---
title: HC32 CAN
version: 0.1

description: >
  This binding gives a base representation of the HC32 CAN controller
  variable value range:
    prop_seg_phase_seg1: 1-64
    phase_seg2: 1-8
    sjw: 1-8

inherits: !include can.yaml

properties:
  compatible:
    constraint: "xhsc,hc32-can"

  reg:
    type: array
    description: register base address
    generation: define
    category: required

  interrupts:
    type: array
    category: required
    description: required interrupts
    generation: define

  interrupt-names:
    type: array
    category: optional
    description: names off the interrupt lines

  clocks:
    type: array
    category: required
    description: Clock gate control information
    generation: define
...
```

## dts/bindings/clock/xhsc,hc32-bus-fcg.yaml
```yaml
# Copyright (C) 2022-2024, Xiaohua Semiconductor Co., Ltd.
# SPDX-License-Identifier: Apache-2.0
---
title: HC32 Bus FCG
version: 0.1

description: >
        enable peripherals clock.

properties:
    compatible:
      type: string
      category: required
      description: compatible strings
      constraint: "xhsc,hc32-bus-fcg"
      generation: define

    reg:
      type: array
      description: mmio register space
      generation: define
      category: required

"cells":
  - bus
  - fcg
  - bits
...
```

## dts/bindings/clock/xhsc,hc32-clk.yaml
```yaml
# Copyright (C) 2022-2024, Xiaohua Semiconductor Co., Ltd.
# SPDX-License-Identifier: Apache-2.0
---
title: HC32 CLOCK CONTROL
version: 0.1

description: >
        HC32 Bus FCG.enable peripherals clock.

properties:
    compatible:
      type: string
      category: required
      description: compatible strings
      constraint: "xhsc,hc32-clk"
      generation: define

    label:
      type: string
      category: required
      description: used by Zephyr for API name
      generation: define

...
```

## dts/bindings/counter/xhsc,hc32-timer6-counter.yaml
```yaml
# Copyright (C) 2022-2024, Xiaohua Semiconductor Co., Ltd.
#
# SPDX-License-Identifier: Apache-2.0

description: HC32 counter

compatible: "xhsc,hc32-timer6-counter"

include: [base.yaml]

properties:
  max-ch:
    type: int
    required: true
    description: Set max channel number.
```

## dts/bindings/counter/xhsc,hc32-timera-counter.yaml
```yaml
# Copyright (C) 2022-2024, Xiaohua Semiconductor Co., Ltd.
#
# SPDX-License-Identifier: Apache-2.0

---
title: HC32 Timera Counters
version: 0.1

description: >
  This binding gives a base representation of the HC32 counter

properties:
  compatible:
    type: string
    category: required
    description: compatible strings
    constraint: "xhsc,hc32-timera-counter"
    generation: define

  label:
    type: string
    category: required
    description: Human readable string describing the device (used by Zephyr for API name)
    generation: define

  ch-nums:
    type: int
    category: required
    description: counter channel numbers
    generation: define
...
```

## dts/bindings/dma/xhsc,hc32-dma.yaml
```yaml
# Copyright (C) 2022-2024, Xiaohua Semiconductor Co., Ltd.
# SPDX-License-Identifier: Apache-2.0

description: |
  HC32 DMA controller

  a phandle to the DMA controller plus the following four integer cells:
    1. channel: the dma channel from 0 to <dma-requests>
    2. slot: DMA triger source, which is the event source number
       this value please ref RM INTC chapter
    3. channel-config: A 32bit mask specifying the DMA channel configuration
    which is device dependent:
        -bit 4-5 : Direction  (see dma.h)
               0x0: MEM to MEM
               0x1: MEM to PERIPH
               0x2: PERIPH to MEM
               0x3: reserved for PERIPH to PERIPH
        -bit 6-7 : Source Increment Address
               0x0: increment address between transfers
               0x1: decrement address between transfers
               0x2: no address increment between transfers
               0x3: reserved
        -bit 8-9 : Dest Increment Address
               0x0: increment address between transfers
               0x1: decrement address between transfers
               0x2: no address increment between transfers
               0x3: reserved
        -bit 10-11 : data size (source and dest all use this parameter)
               0x0: Byte (8 bits)
               0x1: Half-word (16 bits)
               0x2: Word (32 bits)
               0x3: reserved
        -bit 12-31 : reserved

    examples for hc32f460
     dma2: dma-controller@40020400 {
         compatible = "xhsc,hc32-dma";
         ...
         dma-requests = <511>;
         status = "disabled";
        };

  For the client part, example for hc32f460 on DMA2 instance
    Tx using channel 0
    Rx using channel 3
    spi1 {
     dmas = <&dma2 0 EVT_SRC_SPI1_SPTI (HC32_DMA_MEMORY_TO_PERIPH | HC32_DMA_SOURCE_ADDR_INC | HC32_DMA_DEST_ADDR_FIX | HC32_DMA_DATA_WIDTH_8BIT)>,
            <&dma2 3 EVT_SRC_SPI1_SPRI (HC32_DMA_PERIPH_TO_MEMORY | HC32_DMA_SOURCE_ADDR_FIX | HC32_DMA_DEST_ADDR_INC | HC32_DMA_DATA_WIDTH_8BIT)>;
     dma-names = "tx", "rx";
     };

compatible: "xhsc,hc32-dma"

include: dma-controller.yaml

properties:
  reg:
    required: true

  interrupts:
    required: true

  "#dma-cells":
    const: 3

dma-cells:
  - channel
  - slot
  - channel-config
```

## dts/bindings/flash_controller/xhsc,hc32-flash-controller.yaml
```yaml
description: HC32 F4 flash controller

compatible: "xhsc,hc32-flash-controller"

include: flash-controller.yaml
```

## dts/bindings/flash_controller/xhsc,hc32-qspi-nor.yaml
```yaml
description: |
    Refer to the test example, located in
    tests/drivers/flash/common/boards/hc32f460_evb.overlay

compatible: "xhsc,hc32-qspi-nor"

include: ["flash-controller.yaml", "jedec,jesd216.yaml"]

on-bus: qspi

properties:
  reg:
    required: true

  qspi_max_frequency:
    type: int
    required: true
    description: Maximum clock frequency of device's QSPI interface in Hz

  size:
    required: true
    description: Flash Memory size in bits

  page_size:
    type: int
    required: true
    description: Flash program unit size in bytes

  sector_size:
    type: int
    required: true
    description: Erase unit size in bytes
```

## dts/bindings/gpio/xhsc,hc32-gpio.yaml
```yaml
# Copyright (C) 2022-2024, Xiaohua Semiconductor Co., Ltd.
# SPDX-License-Identifier: Apache-2.0

description: xhsc hc32 GPIO node

compatible: "xhsc,hc32-gpio"

include: [gpio-controller.yaml, base.yaml]

properties:
  reg:
    required: true

  "#gpio-cells":
    const: 2

gpio-cells:
  - pin
  - flags
```

## dts/bindings/i2c/xhsc,hc32-i2c.yaml
```yaml
#
# Copyright (c) 2017 I-SENSE group of ICCS
#
# SPDX-License-Identifier: Apache-2.0
#
---
title: HC32 I2C V2
version: 0.1

description: >
    HC32 I2C controller

inherits:
    !include i2c.yaml

properties:
    compatible:
      constraint: "xhsc,hc32-i2c"

    reg:
      type: array
      description: mmio register space
      generation: define
      category: required

    interrupts:
      type: array
      category: required
      description: required interrupts
      generation: define

    interrupt-names:
      type: stringlist
      category: optional
      description: readable string describing the interrupts
      generation: define

    int-nums:
      type: int
      category: required
      generation: define

    dmas:
      type: compound
      category: option
      generation: define

    dma-names:
      type: stringlist
      category: option
      generation: define

    scl-gpios:
      type: compound
      category: option
      description: |
        GPIO to which the I2C SCL signal is routed. This is only needed for
        I2C bus recovery support.

    sda-gpios:
      type: compound
      category: option
      description: |
        GPIO to which the I2C SDA signal is routed. This is only needed for
        I2C bus recovery support.
...
```

## dts/bindings/i2s/xhsc,hc32-i2s.yaml
```yaml
# Copyright (C) 2022-2024, Xiaohua Semiconductor Co., Ltd.
# SPDX-License-Identifier: Apache-2.0

description: HC32 I2S controller

compatible: "xhsc,hc32-i2s"

include: [i2s-controller.yaml, pinctrl-device.yaml, base.yaml]

properties:
  reg:
    required: true

  dmas:
    type: phandle-array
    required: true

  dma-names:
    type: string-array
    required: true
    description: |
      Names for the provided states. The number of names needs to match the
      number of states.

  pinctrl-0:
    required: true

  pinctrl-names:
    required: true

  tx-fifo-level:
    type: int
    default: 2
    enum:
      - 0
      - 1
      - 2
      - 3
      - 4
    description: tx fifo level, total 4.
                 when useful space gather than level, the SR.TXBA is set 1

  rx-fifo-level:
    type: int
    default: 2
    enum:
      - 0
      - 1
      - 2
      - 3
      - 4
    description: rx fifo level, total 4.
                 when useful space less than level, the SR.RXBA is set 1

  src-clk:
    type: int
    required: true
    default: 0
    enum:
      - 0 
      - 1
    description: i2s source clock. 0-pll, 1-exclk

  i2s-pll-clk:
    type: int
    enum:
      - 0 #PCLK1
      - 8 #PLLHQ
      - 9 #PLLHR
      - 10 #PLLAP
      - 11 #PLLAQ
      - 12 #PLLAR 


  mck-enabled:
    type: boolean
```

## dts/bindings/iio/adc/xhsc,hc32-adc.yaml
```yaml
#
# Copyright (C) 2022-2024, Xiaohua Semiconductor Co., Ltd.
#
# SPDX-License-Identifier: Apache-2.0
#
---
title: XHSC Semiconductor ADC
version: 0.1

description: >
    This is a representation of the XHSC ADC node

inherits:
    !include adc.yaml

properties:
    compatible:
      type: string
      category: required
      description: compatible strings
      constraint: "xhsc,hc32-adc"

    reg:
      type: array
      description: mmio register space
      generation: define
      category: required

    interrupts:
      type: array
      category: required
      description: required interrupts
      generation: define

    dma-read:
      type: int
      category: optional
      description: dma configuration
      generation: define
...
```

## dts/bindings/interrupt-controller/xhsc,hc32-extint.yaml
```yaml
#
# Copyright (C) 2022-2024, Xiaohua Semiconductor Co., Ltd.
#
# SPDX-License-Identifier: Apache-2.0
#
---
title: HC32 External Interrupt Controller
version: 0.1

description: >
  This binding gives a base representation of the HC32 Interrupt Controller

properties:
  compatible:
    category: required
    type: string
    description: compatible strings
    constraint: "xhsc,hc32-extint"
    generation: define

  reg:
    category: required
    type: array
    description: mmio register space
    generation: define

  label:
    category: required
    type: string
    description: Human readable string describing the device
    generation: define

  interrupts:
    category: required
    type: array
    description: required interrupts
    generation: define

  interrupt-names:
    category: optional
    type: stringlist
    description: names of required interrupts
    generation: define

  extint-nums:
    category: required
    type: int
    description: Number of extint supported by the interrupt controller.
    generation: define

  extint-chs:
    category: required
    type: array
    description: Description of the external channel for each interrupt vector.
    generation: define
...
```

## dts/bindings/interrupt-controller/xhsc,hc32-intc.yaml
```yaml
#
# Copyright (C) 2022-2024, Xiaohua Semiconductor Co., Ltd.
#
# SPDX-License-Identifier: Apache-2.0
#
---
title: HC32 Interrupt Controller
version: 0.1

description: >
  This binding gives a base representation of the HC32 Interrupt Controller

properties:
  compatible:
    category: required
    type: string
    description: compatible strings
    constraint: "xhsc,hc32-intc"
    generation: define

  reg:
    category: required
    type: array
    description: mmio register space
    generation: define

  label:
    category: required
    type: string
    description: Human readable string describing the device
    generation: define

"#cells":
  - irq
  - priority
  - int_src
```
