## dts/bindings/pinctrl/xhsc,hc32-pinctrl.yaml
```yaml
# Copyright (C) 2022-2024, Xiaohua Semiconductor Co., Ltd.
# SPDX-License-Identifier: Apache-2.0

description: |
  xhsc hc32 pinctrl node.

  Pins can be configured using the following macro "K3_PINMUX(offset, value, mux_mode)".
  offset - the pin attribute register offset from the base address.
  value - one of the following:
    PIN_OUTPUT
    PIN_OUTPUT_PULLUP
    PIN_OUTPUT_PULLDOWN
    PIN_INPUT
    PIN_INPUT_PULLUP
    PIN_INPUT_PULLDOWN
  mux_mode - The mux mode for the pin, MUX_MODE_0 -> MUX_MODE_9.
  e.g. for AM62x the pinctrl base address is 0xf4000.
       The default UART0_RX pin is located at 0x000f41c8 (mux mode 0).
       So the configuration would be "K3_PINMUX(0x1c8, PIN_INPUT, MUX_MODE_0)".

compatible: "xhsc,hc32-pinctrl"

include: base.yaml

properties:
  reg:
    required: true
```

## dts/bindings/pwm/xhsc,hc32-timer-pwm.yaml
```yaml
# Copyright (C) 2022-2024, Xiaohua Semiconductor Co., Ltd.
#
# SPDX-License-Identifier: Apache-2.0

description: HC32 TIMER PWM

compatible: "xhsc,hc32-timer-pwm"

include: [pwm-controller.yaml, base.yaml, pinctrl-device.yaml]

properties:
  pinctrl-0:
    required: true

  pinctrl-names:
    required: true

  "#pwm-cells":
    const: 3
    description: |
      Number of items to expect in a PWM

pwm-cells:
  - channel
  - period
  - flags
```

## dts/bindings/pwm/xhsc,hc32-timer6-pwm.yaml
```yaml
# Copyright (C) 2022-2024, Xiaohua Semiconductor Co., Ltd.
#
# SPDX-License-Identifier: Apache-2.0

description: HC32 TIMER6 PWM

compatible: "xhsc,hc32-timer6-pwm"

include: ["xhsc,hc32-timer-pwm.yaml"]
```

## dts/bindings/pwm/xhsc,hc32-timera-pwm.yaml
```yaml
# Copyright (C) 2022-2024, Xiaohua Semiconductor Co., Ltd.
#
# SPDX-License-Identifier: Apache-2.0

description: HC32 TIMERA PWM

compatible: "xhsc,hc32-timera-pwm"

include: ["xhsc,hc32-timer-pwm.yaml"]
```

## dts/bindings/qspi/xhsc,hc32-qspi.yaml
```yaml
# Copyright (C) 2022-2024, Xiaohua Semiconductor Co., Ltd.
# SPDX-License-Identifier: Apache-2.0

description: |
    Refer to the test example, located in
    tests/drivers/flash/common/boards/hc32f460_evb.overlay

compatible: "xhsc,hc32-qspi"

include: [base.yaml, pinctrl-device.yaml]

bus: qspi

properties:
  reg:
    required: true

  interrupts:
    description: |
      Optional.

  clock_divider:
    type: int
    default: 2
    description: |
      Divide HCLK for QSPI bus.
      Calculation formula is qspi_clock = hclk / clock_divider.
      The max divider is 64, and the min divider is 2.

  dummy_cycles:
    type: int
    required: true
    enum: [0, 1, 2, 3, 4, 5, 6, 7, 8, 9, 10, 11, 12, 13, 14, 15]
    default: 3
    description: |
      Read dummy cycles.
      0: 3 cycles
      1: 4 cycles
      2: 5 cycles
      ...
      15: 18 cycles

  read_mode:
    type: int
    enum: [0, 1, 2, 3, 4, 5 ,6 ,7]
    default: 0
    description: |
      0: Standard read mode (no dummy cycles)
      1: Fast read mode (dummy cycles between address and data)
      2: Fast read dual output mode (data on 2 lines)
      3: Fast read dual I/O mode (address and data on 2 lines)
      4: Fast read quad output mode (data on 4 lines)
      5: Fast read quad I/O mode (address and data on 4 lines)
      6: Custom standard read mode
      7: Custom fast read mode

  addr_width:
    type: int
    enum: [0, 1, 2, 3, 7]
    default: 0
    description: |
      0: memory bus  8 bit.
      1: memory bus 16 bit.
      2: memory bus 24 bit.
      3: memory bus 32 bit, don't use 4-byte command.
      7: memory bus 32 bit, command 4 byte.

  cs_setup_time:
    type: int
    enum: [0, 1]
    default: 0
    description: |
      0: CS output 0.5-QSCK ahead of the first rising edge of QSCK.
      1: CS output 1.5-QSCK ahead of the first rising edge of QSCK.

  cs_release_time:
    type: int
    enum: [0, 1]
    default: 0
    description: |
      0: Release CS 0.5-QSCKs after the last rising edge of QSCK.
      1: Release CS 1.5-QSCKs after the last rising edge of QSCK.

  pinctrl-0:
    required: true

  pinctrl-names:
    required: true

  dmas:
    description: |
      Optional DMA channel specifier.

  dma-names:
    description: |
      DMA channel name. If DMA should be used, expected value is "qspi_tx".

      For example
         dma-names = "qspi_tx";
```

## dts/bindings/rtc/xhsc,hc32-rtc.yaml
```yaml
# Copyright (C) 2022-2024, Xiaohua Semiconductor Co., Ltd.
# SPDX-License-Identifier: Apache-2.0
---
title: HC32 RTC
version: 0.1

description: >
    This binding gives a base representation of the HC32 RTC

inherits:
    !include rtc.yaml

properties:
    compatible:
      type: string
      category: required
      description: compatible strings
      constraint: "xhsc,hc32-rtc"

    reg:
      type: array
      description: mmio register space
      generation: define
      category: required

    clock-src:
      type: int
      category: required
      description: Clock src, HC32_CLK_SRC_LRC or HC32_CLK_SRC_XTAL32
      generation: define
...
```

## dts/bindings/sensor/xhsc,hc32-qdec.yaml
```yaml
# Copyright (c) 2022, Valerio Setti <vsetti@baylibre.com
# SPDX-License-Identifier: Apache-2.0

description: HC32 quadrature decoder

compatible: "xhsc,hc32-qdec"

include:
  - name: base.yaml
  - name: pinctrl-device.yaml

properties:
  pinctrl-0:
    required: true

  pinctrl-names:
    required: true

  hw-count-conditions:
    type: int
    required: true
    description: |
      Encoder is triggered by hardware up count conditions
      bit0: When CLKA is low, a rising edge is sampled on CLKB
      bit1: When CLKA is low, a falling edge is sampled on CLKB
      bit2: When CLKA is high, a rising edge is sampled on CLKB
      bit3: When CLKA is high, a falling edge is sampled on CLKB
      bit4: When CLKB is low, a rising edge is sampled on CLKA
      bit5: When CLKB is low, a rising edge is sampled on CLKA
      bit6: When CLKB is high, a rising edge is sampled on CLKA
      bit7: When CLKB is high, a falling edge is sampled on CLKA
      bit8: When a rising edge occurred on TRIG
      bit9: When a falling edge occurred on TRIG
      bit11: When the symmetric unit overflow
      bit12: When the symmetric unit underflow
      Encoder is triggered by hardware down count conditions
      bit16: When CLKA is low, a rising edge is sampled on CLKB
      bit17: When CLKA is low, a falling edge is sampled on CLKB
      bit18: When CLKA is high, a rising edge is sampled on CLKB
      bit19: When CLKA is high, a falling edge is sampled on CLKB
      bit20: When CLKB is low, a rising edge is sampled on CLKA
      bit21: When CLKB is low, a rising edge is sampled on CLKA
      bit22: When CLKB is high, a rising edge is sampled on CLKA
      bit23: When CLKB is high, a falling edge is sampled on CLKA
      bit24: When a rising edge occurred on TRIG
      bit25: When a falling edge occurred on TRIG
      bit27: When the symmetric unit overflow
      bit28: When the symmetric unit underflow

  filter-config:
    type: int
    description: |
      bit13-14: TIMA_<t>_CLKB port filter clock select
      bit9-10: TIMA_<t>_CLKA port filter clock select
      - 00b  # TMRA_FILTER_CLK_DIV1
      - 01b  # TMRA_FILTER_CLK_DIV4
      - 10b  # TMRA_FILTER_CLK_DIV16
      - 11b  # TMRA_FILTER_CLK_DIV64
      bit12: TIMA_<t>_CLKA port filter enable
      bit8: TIMA_<t>_CLKA port filter enable
      - 0 disable
      - 1 enable

  counts-per-revolution:
    type: int
    required: true
    description: |
      This is a number >= 1 that is used to determine how many revolutions
      were done based on the current counter's value.
```
