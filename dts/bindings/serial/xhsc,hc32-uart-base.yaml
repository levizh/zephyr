## dts/bindings/serial/xhsc,hc32-uart-base.yaml
```yaml
# Copyright (c) 2020 STMICROELECTRONICS
# SPDX-License-Identifier: Apache-2.0

# Common fields for HC32 UART peripherals.
description: HC32 UART-BASE

include: [uart-controller.yaml, pinctrl-device.yaml, reset-device.yaml]

properties:
  reg:
    required: true

  # clocks:
  #   required: true

  # resets:
  #   required: true

  interrupts:
    required: true

  interrupt-names:
    required: true

  enintsrc:
    required: true
    type: array
    description: |
      Peripheral interrupt number

  single-wire:
    type: boolean
    description: |
      Enable the single wire half-duplex communication.
      Using this mode, TX and RX lines are internally connected and
      only TX pin is used afterwards and should be configured.
      RX/TX conflicts must be handled on user side.

  tx-rx-swap:
    type: boolean
    description:
      Swap the TX and RX pins. Used in case of a cross wired connection.

  pinctrl-0:
    required: true

  pinctrl-names:
    required: true

  wakeup-line:
    type: int
    description: |
      EXTI line number matching the device wakeup interrupt mask register.
      This property is required on stm32 devices where the wakeup interrupt signal could be
      configured masked at boot (sm32wl55 for instance), preventing the device to wakeup
      the core from stop mode(s).
      Valid range: 0 - 31
```

## dts/bindings/serial/xhsc,hc32-uart.yaml
```yaml
description: HC32 UART

compatible: "xhsc,hc32-uart"

include: xhsc,hc32-uart-base.yaml
```

## dts/bindings/serial/xhsc,hc32-usart.yaml
```yaml
---
title: HC32 USART
version: 0.1

description: >
    This binding gives a base representation of the HC32 USART

inherits:
    !include uart.yaml

properties:
    compatible:
      constraint: "xhsc,hc32-usart"

    reg:
      type: array
      description: mmio register space
      generation: define
      category: required

    interrupts:
      category: optional
      type: array
      description: required interrupts
      generation: define

    interrupt-names:
      category: optional
      type: stringlist
      description: names of required interrupts
      generation: define

    dma-tx:
      type: int
      category: optional
      description: dma configuration
      generation: define

    dma-rx:
      type: int
      category: optional
      description: dma configuration
      generation: define
...
```

## dts/bindings/spi/xhsc,hc32-qspi.yaml
```yaml
# Copyright (C) 2022-2024, Xiaohua Semiconductor Co., Ltd.
# SPDX-License-Identifier: Apache-2.0

title: HC32 QSPI
version: 0.1

description: >
    This binding gives a base representation of the HC32 QSPI controller

properties:
    compatible:
      constraint: "xhsc,hc32-qspi"

    reg:
      type: array
      description: mmio register space
      generation: define
      category: required

    compatible:
      type: string
      category: required
      description: compatible strings
      generation: define

    clocks:
      type: array
      category: optional
      description: Clock gate information
      generation: define

    label:
      type: string
      category: required
      description: Human readable string describing the device (used by Zephyr for API name)
      generation: define

    dma-tx-cfg:
      type: int
      category: optional
      description: dma configuration
      generation: define

    dma-rx-cfg:
      type: int
      category: optional
      description: dma configuration
      generation: define
```

## dts/bindings/spi/xhsc,hc32-spi.yaml
```yaml
# Copyright (C) 2022-2024, Xiaohua Semiconductor Co., Ltd.
# SPDX-License-Identifier: Apache-2.0

description: XHSC HC32 SPI

compatible: "xhsc,hc32-spi"

include: [spi-controller.yaml, reset-device.yaml, pinctrl-device.yaml]

properties:
  reg:
    required: true

  interrupts:
    required: true

  interrupt-names:
    required: true

  clocks:
    required: true

  pinctrl-0:
    required: true

  pinctrl-names:
    required: true
```

## dts/bindings/timer/xhsc,hc32-timera.yaml
```yaml
---
title: HC32 TIMERAS
version: 0.1

description: >
    This binding gives a base representation of the HC32 TIMERAS

properties:
    compatible:
      type: string
      category: required
      description: compatible strings
      constraint: "xhsc,hc32-timera"
      generation: define

    label:
      type: string
      category: required
      description: Human readable string describing the device (used by Zephyr for API name)
      generation: define

    reg:
      type: array
      description: mmio register space
      generation: define
      category: required

    clocks:
      type: array
      category: required
      description: Clock gate information
      generation: define

    interrupts:
      type: array
      category: required
      description: required interrupts
      generation: define

    interrupt-names:
      type: stringlist
      category: optional
      description: readable string describing the interrupts

    clock-division:
      type: int
      category: required
      default: 0 # HC32_TMR_CNT_CLK_DIV1 - reset state
      description: |
        Set timer count clock division.
        Use constants defined in dt-bindings/timer/hc32-timer.h.
      generation: define

    count-mode:
      type: int
      category: required
      default: 0 # HC32_TMR_CNT_MD_SAWTOOTH - reset state
      description: |
        Set timer count mode.
        Use constants defined in dt-bindings/timer/hc32-timer.h.
      generation: define

    count-direction:
      type: int
      category: required
      default: 0 # HC32_TMR_CNT_DIR_UP - reset state
      description: |
        Set timer count direction.
        Use constants defined in dt-bindings/timer/hc32-timer.h.
      generation: define
...
```

## dts/bindings/watchdog/xhsc,hc32-specialized-watchdog.yaml
```yaml
# Copyright (C) 2022-2024, Xiaohua Semiconductor Co., Ltd.
# SPDX-License-Identifier: Apache-2.0

description: HC32 specialized watchdog

compatible: "xhsc,hc32-specialized-watchdog"

include: base.yaml

properties:
  reg:
    required: true
```

## dts/bindings/watchdog/xhsc,hc32-watchdog.yaml
```yaml
# Copyright (C) 2022-2024, Xiaohua Semiconductor Co., Ltd.
# SPDX-License-Identifier: Apache-2.0
---
title: HC32 watchdog driver
version: 0.1
description: This is a representation of the HC32 watchdog

properties:
  compatible:
    type: string
    category: required
    description: compatible strings
    constraint: "xhsc,hc32-watchdog"
    generation: define

  reg:
    type: int
    description: mmio register space
    generation: define
    category: required

  label:
    type: string
    category: required
    description: Human readable string describing the device (used by Zephyr for API name)
    generation: define
```

## soc/arm/xhsc_hc32/Kconfig
```kconfig
#
# Copyright (C) 2022-2024, Xiaohua Semiconductor Co., Ltd.
#
# SPDX-License-Identifier: Apache-2.0
#

config SOC_FAMILY_HC32
	bool

if SOC_FAMILY_HC32

config SOC_FAMILY
	string
	default "xhsc_hc32"

source "soc/arm/xhsc_hc32/*/Kconfig.soc"

endif # SOC_FAMILY_HC32
```

## soc/arm/xhsc_hc32/Kconfig.defconfig
```kconfig
#
# Copyright (c) 2018, xhsc
#
# SPDX-License-Identifier: Apache-2.0
#

source "soc/arm/xhsc_hc32/*/Kconfig.defconfig.series"
```

## soc/arm/xhsc_hc32/Kconfig.soc
```kconfig
#
# Copyright (C) 2022-2024, Xiaohua Semiconductor Co., Ltd.
#
# SPDX-License-Identifier: Apache-2.0
#

source "soc/arm/xhsc_hc32/*/Kconfig.series"
```

## soc/arm/xhsc_hc32/common/Kconfig.defconfig.series
```kconfig
# Kconfig.defconfig.series - XHSC HC32 all MCU lines
#
# Copyright (c) 2024, CDT
#
# SPDX-License-Identifier: Apache-2.0
#

# Here are set all the Kconfig symbols common to the whole HC32 family

if SOC_FAMILY_HC32

if SERIAL

config UART_HC32
	bool
	default y

endif #SERIAL

if I2C

config I2C_HC32
	default y

endif #I2C

endif # SOC_FAMILY_HC32
```

## soc/arm/xhsc_hc32/hc32f4/Kconfig.defconfig.series
```kconfig
# Kconfig.defconfig.series - xhsc hc32f460 configuration
# options
#
# Copyright (C) 2022-2024, Xiaohua Semiconductor Co., Ltd.
#
# SPDX-License-Identifier: Apache-2.0
#

if SOC_SERIES_HC32F4

config SOC_SERIES
	default "hc32f4"

source "soc/arm/xhsc_hc32/hc32f4/Kconfig.defconfig.hc32f4*"

endif # SOC_SERIES_HC32F4
```

## soc/arm/xhsc_hc32/hc32f4/Kconfig.series
```kconfig
# Kconfig.series - xhsc f460 MCU line
#
# Copyright (C) 2022-2024, Xiaohua Semiconductor Co., Ltd.
#
# SPDX-License-Identifier: Apache-2.0
#

config SOC_SERIES_HC32F4
	bool "xhsc hc32f4 series MCU"
    select ARM
	select SOC_FAMILY_HC32
	select CPU_CORTEX_M_HAS_SYSTICK
	select CPU_CORTEX_M_HAS_VTOR
	select CPU_CORTEX_M4
	select CPU_HAS_ARM_MPU
	select CPU_HAS_FPU
	select HAS_HC32_DDL
	select CLOCK_CONTROL_HC32 if CLOCK_CONTROL
	help
	  Enable support for xhsc hc32f4 MCU series
```

## soc/arm/xhsc_hc32/hc32f4/Kconfig.soc
```kconfig
# Kconfig.soc - xhsc f460 MCU line
#
# Copyright (C) 2022-2024, Xiaohua Semiconductor Co., Ltd.
#
# SPDX-License-Identifier: Apache-2.0
#

choice
prompt "XHSC HC32F4 MCU Selection"
depends on SOC_SERIES_HC32F4

config SOC_HC32F460
	bool "HC32F460"
	select PLATFORM_SPECIFIC_INIT
	#PLATFORM_SPECIFIC_INIT uesed for set sram3 R/W cycles = 2

config SOC_HC32F4A0
	bool "HC32F4A0"
	select PLATFORM_SPECIFIC_INIT

endchoice
```

## soc/xhsc/hc32/hc32f4xx/Kconfig.defconfig.hc32f460
```kconfig
# Kconfig - xhsc hc32f460 platform configuration options
#
# Copyright (C) 2022-2024, Xiaohua Semiconductor Co., Ltd.
#
# SPDX-License-Identifier: Apache-2.0
#

if SOC_HC32F460

config NUM_IRQS
	int
	# must be >= the highest interrupt number used
	default 143

config SYS_CLOCK_TICKS_PER_SEC
	default 1000

config SYS_CLOCK_HW_CYCLES_PER_SEC
	default 8000000

config HC32_DDL_DEBUG
	bool "if enable assert function in hc32_ddl drivers"
	default n

config HC32_FLASH_CONFIG_OFFSET
	hex "HC32 flash configuration field offset"
	default 0x400

if GPIO

config GPIO_HC32
	default y

endif # GPIO

if PINMUX

config PINMUX_HC32
	bool
	default y

endif #PINMUX

if I2C
config I2C_HC32
	default y
endif # I2C

endif # SOC_HC32F460
```

## soc/xhsc/hc32/hc32f4xx/Kconfig.defconfig.hc32f4a0
```kconfig
# Kconfig - xhsc hc32f4a0 platform configuration options
#
# Copyright (C) 2022-2024, Xiaohua Semiconductor Co., Ltd.
#
# SPDX-License-Identifier: Apache-2.0
#

if SOC_HC32F4A0

config SOC
	string
	default "hc32f4a0"

config NUM_IRQS
	int
	# must be >= the highest interrupt number used
	default 143

config SYS_CLOCK_TICKS_PER_SEC
	default 1000

config SYS_CLOCK_HW_CYCLES_PER_SEC
	default 8000000

config HC32_DDL_DEBUG
	bool "if enable assert function in hc32_ddl drivers"
	default n

config HC32_FLASH_CONFIG_OFFSET
	hex "HC32 flash configuration field offset"
	default 0x400

if GPIO

config GPIO_HC32
	default y

endif # GPIO

if PINMUX

config PINMUX_HC32
	bool
	default y

endif #PINMUX

if I2C
config I2C_HC32
	default y
endif # I2C

if I2S
config I2S_HC32
	default y
endif # I2S

endif # SOC_HC32F4A0
```

## tests/drivers/flash/common/boards/hc32f460_evb.conf
```kconfig
# Setting "y" to test external QSPI NOR Flash
# Setting "n" to test internal SOC NOR Flash

CONFIG_FLASH_HC32_QSPI=y
```

## tests/drivers/pinctrl/hc32/testcase.yaml
```yaml
# Copyright (c) 2021 Teslabs Engineering S.L.
# SPDX-License-Identifier: Apache-2.0

tests:
  drivers.pinctrl.hc32:
    tags:
      - drivers
      - pinctrl
    platform_allow: hc32f460_evb
```
