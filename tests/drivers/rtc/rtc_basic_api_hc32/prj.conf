## prj.conf
```kconfig
#CONFIG_RTC=y
CONFIG_COUNTER=y
CONFIG_ZTEST=y

CONFIG_NO_OPTIMIZATIONS=y
CONFIG_MAIN_STACK_SIZE=10240
```

## src/main.c
```c
/*
 * Copyright (c) 2016 Intel Corporation
 *
 * SPDX-License-Identifier: Apache-2.0
 */

/**
 * @addtogroup t_driver_rtc
 * @{
 * @defgroup t_rtc_basic_api test_rtc_basic_api
 * @}
 */

#include "test_rtc.h"

void test_main(void)
{
#if 0
	ztest_test_suite(rtc_basic_test,
			 ztest_unit_test(test_rtc_alarm),
			 ztest_unit_test(test_rtc_calendar));
#endif
	ztest_test_suite(rtc_basic_test,
			 ztest_unit_test(test_rtc_calendar));
	ztest_run_test_suite(rtc_basic_test);
}
```

## src/test_rtc.h
```c
/*
 * Copyright (c) 2016 Intel Corporation
 *
 * SPDX-License-Identifier: Apache-2.0
 */

/**
 * @file
 * @brief RTC cases header file
 *
 * Header file for RTC cases
 */

#ifndef __TEST_RTC_H__
#define __TEST_RTC_H__

#include <rtc.h>
#include <zephyr.h>
#include <ztest.h>

#define RTC_DEVICE_NAME DT_XHSC_HC32_RTC_0_LABEL

void test_rtc_calendar(void);
void test_rtc_alarm(void);

#endif /* __TEST_RTC_H__ */
```
