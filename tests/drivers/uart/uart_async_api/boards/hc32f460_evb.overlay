/* SPDX-License-Identifier: Apache-2.0 */

dut: &usart2 {
	status = "okay";
	current-speed = <115200>;
	pinctrl-0 = <&usart2_default>;
	pinctrl-names = "default";
	dmas =  <&dma1 3 EVT_SRC_USART2_TI (HC32_DMA_MEMORY_TO_PERIPH | HC32_DMA_SOURCE_ADDR_INC | HC32_DMA_DEST_ADDR_FIX | HC32_DMA_DATA_WIDTH_8BIT)>,
			<&dma1 0 EVT_SRC_USART2_RI (HC32_DMA_PERIPH_TO_MEMORY | HC32_DMA_SOURCE_ADDR_FIX | HC32_DMA_DEST_ADDR_INC | HC32_DMA_DATA_WIDTH_8BIT)>;
	dma-names = "tx", "rx";
};

&dma1 {
	status = "okay";
};
