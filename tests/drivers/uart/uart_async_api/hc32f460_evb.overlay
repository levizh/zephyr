
&usart2 {
	current-speed = <230400>;
	dma-tx = <(HC32_DT_DMA_UNIT(DMA2) | HC32_DT_DMA_CH(1) | HC32_DT_DMA_SLOT(EVT_SRC_USART2_TI))>;
	dma-rx = <(HC32_DT_DMA_UNIT(DMA1) | HC32_DT_DMA_CH(1) | HC32_DT_DMA_SLOT(EVT_SRC_USART2_RI))>;
	status = "ok";
};

// &usart4 {
// 	dma-tx =  <(HC32_DT_DMA_UNIT(DMA1) | HC32_DT_DMA_CH(2) | HC32_DT_DMA_SLOT(EVT_SRC_USART4_TCI))>;
// 	dma-rx = <(HC32_DT_DMA_UNIT(DMA1) | HC32_DT_DMA_CH(1) | HC32_DT_DMA_SLOT(EVT_SRC_USART4_RI))>;
// };

&dma1 {
	status = "ok";
};

&dma2 {
	status = "ok";
};
